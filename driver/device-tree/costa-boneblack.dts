#include "am335x-boneblack.dtsi"

&i2c2 {
    clock-frequency = <100000>;
    pinctrl-names = "default";
    pinctrl-0 = <&i2c2_pins>;
    status = "okay";

    bmp280@76 {
        compatible = "bosch,bmp280";
        reg = <0x76>;
        status = "okay";
    };
};